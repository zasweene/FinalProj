## build_3/Kconfig/boards/Kconfig.sysbuild
```kconfig
# Load Sysbuild board Kconfig descriptions.
osource "D:/Downloads/nordictest/sdk/zephyr/boards/nordic/nrf52840dk/Kconfig.sysbuild"
```

## build_5/Kconfig/boards/Kconfig
```kconfig
# Load Zephyr board Kconfig descriptions.
osource "D:/Downloads/nordictest/sdk/zephyr/boards/nordic/nrf52840dk/Kconfig"
```

## build_5/Kconfig/boards/Kconfig.defconfig
```kconfig
# Load Zephyr board defconfig descriptions.
osource "D:/Downloads/nordictest/sdk/zephyr/boards/nordic/nrf52840dk/Kconfig.defconfig"
```

## build_5/ex_02d_rx_sniff/Kconfig/Kconfig.shield
```kconfig
osource "D:/Downloads/nordictest/blinky_pwm/boards/shields/*/Kconfig.shield"
osource "D:/Downloads/dwm3000-master/examples/ex_02d_rx_sniff/../../boards/shields/*/Kconfig.shield"
osource "D:/Downloads/nordictest/sdk/nrf/boards/shields/*/Kconfig.shield"
```

## build_5/ex_02d_rx_sniff/Kconfig/Kconfig.shield.defconfig
```kconfig
osource "D:/Downloads/nordictest/blinky_pwm/boards/shields/*/Kconfig.defconfig"
osource "D:/Downloads/dwm3000-master/examples/ex_02d_rx_sniff/../../boards/shields/*/Kconfig.defconfig"
osource "D:/Downloads/nordictest/sdk/nrf/boards/shields/*/Kconfig.defconfig"
```

## build_6/Kconfig/Kconfig.modules
```kconfig
menu "nrf (D:/Downloads/nordictest/sdk/nrf)"
osource "D:/Downloads/nordictest/sdk/nrf/Kconfig.nrf"
config ZEPHYR_NRF_MODULE
	bool
	default y
endmenu
menu "mcuboot (D:/Downloads/nordictest/sdk/bootloader/mcuboot)"
osource "$(ZEPHYR_MCUBOOT_KCONFIG)"
config ZEPHYR_MCUBOOT_MODULE
	bool
	default y
endmenu
menu "mbedtls (D:/Downloads/nordictest/sdk/modules/crypto/mbedtls)"
osource "$(ZEPHYR_MBEDTLS_KCONFIG)"
config ZEPHYR_MBEDTLS_MODULE
	bool
	default y
endmenu
menu "oberon-psa-crypto (D:/Downloads/nordictest/sdk/modules/crypto/oberon-psa-crypto)"
osource "D:/Downloads/nordictest/sdk/modules/crypto/oberon-psa-crypto/Kconfig.oberon_psa_crypto"
config ZEPHYR_OBERON_PSA_CRYPTO_MODULE
	bool
	default y
endmenu
menu "trusted-firmware-m (D:/Downloads/nordictest/sdk/modules/tee/tf-m/trusted-firmware-m)"
osource "$(ZEPHYR_TRUSTED_FIRMWARE_M_KCONFIG)"
config ZEPHYR_TRUSTED_FIRMWARE_M_MODULE
	bool
	default y
endmenu
config ZEPHYR_PSA_ARCH_TESTS_MODULE
	bool
	default y
config ZEPHYR_SOC_HWMV1_MODULE
	bool
	default y
menu "cjson (D:/Downloads/nordictest/sdk/modules/lib/cjson)"
osource "$(ZEPHYR_CJSON_KCONFIG)"
config ZEPHYR_CJSON_MODULE
	bool
	default y
endmenu
menu "azure-sdk-for-c (D:/Downloads/nordictest/sdk/modules/lib/azure-sdk-for-c)"
osource "$(ZEPHYR_AZURE_SDK_FOR_C_KCONFIG)"
config ZEPHYR_AZURE_SDK_FOR_C_MODULE
	bool
	default y
endmenu
menu "cirrus-logic (D:/Downloads/nordictest/sdk/modules/hal/cirrus-logic)"
osource "D:/Downloads/nordictest/sdk/modules/hal/cirrus-logic/Kconfig"
config ZEPHYR_CIRRUS_LOGIC_MODULE
	bool
	default y
endmenu
menu "openthread (D:/Downloads/nordictest/sdk/modules/lib/openthread)"
osource "$(ZEPHYR_OPENTHREAD_KCONFIG)"
config ZEPHYR_OPENTHREAD_MODULE
	bool
	default y
endmenu
menu "suit-generator (D:/Downloads/nordictest/sdk/modules/lib/suit-generator)"
osource "D:/Downloads/nordictest/sdk/modules/lib/suit-generator/ncs/Kconfig"
config ZEPHYR_SUIT_GENERATOR_MODULE
	bool
	default y
endmenu
menu "suit-processor (D:/Downloads/nordictest/sdk/modules/lib/suit-processor)"
osource "D:/Downloads/nordictest/sdk/modules/lib/suit-processor/Kconfig"
config ZEPHYR_SUIT_PROCESSOR_MODULE
	bool
	default y
endmenu
menu "memfault-firmware-sdk (D:/Downloads/nordictest/sdk/modules/lib/memfault-firmware-sdk)"
osource "D:/Downloads/nordictest/sdk/modules/lib/memfault-firmware-sdk/ports/zephyr/Kconfig"
config ZEPHYR_MEMFAULT_FIRMWARE_SDK_MODULE
	bool
	default y
endmenu
menu "coremark (D:/Downloads/nordictest/sdk/modules/benchmark/coremark)"
osource "$(ZEPHYR_COREMARK_KCONFIG)"
config ZEPHYR_COREMARK_MODULE
	bool
	default y
endmenu
menu "canopennode (D:/Downloads/nordictest/sdk/modules/lib/canopennode)"
osource "$(ZEPHYR_CANOPENNODE_KCONFIG)"
config ZEPHYR_CANOPENNODE_MODULE
	bool
	default y
endmenu
menu "chre (D:/Downloads/nordictest/sdk/modules/lib/chre)"
osource "D:/Downloads/nordictest/sdk/modules/lib/chre/platform/zephyr/Kconfig"
config ZEPHYR_CHRE_MODULE
	bool
	default y
endmenu
menu "lz4 (D:/Downloads/nordictest/sdk/modules/lib/lz4)"
osource "$(ZEPHYR_LZ4_KCONFIG)"
config ZEPHYR_LZ4_MODULE
	bool
	default y
endmenu
menu "nanopb (D:/Downloads/nordictest/sdk/modules/lib/nanopb)"
osource "$(ZEPHYR_NANOPB_KCONFIG)"
config ZEPHYR_NANOPB_MODULE
	bool
	default y
endmenu
config ZEPHYR_TF_M_TESTS_MODULE
	bool
	default y
menu "zscilib (D:/Downloads/nordictest/sdk/modules/lib/zscilib)"
osource "D:/Downloads/nordictest/sdk/modules/lib/zscilib/Kconfig.zscilib"
config ZEPHYR_ZSCILIB_MODULE
	bool
	default y
endmenu
menu "cmsis (D:/Downloads/nordictest/sdk/modules/hal/cmsis)"
osource "$(ZEPHYR_CMSIS_KCONFIG)"
config ZEPHYR_CMSIS_MODULE
	bool
	default y
endmenu
menu "cmsis-dsp (D:/Downloads/nordictest/sdk/modules/lib/cmsis-dsp)"
osource "$(ZEPHYR_CMSIS_DSP_KCONFIG)"
config ZEPHYR_CMSIS_DSP_MODULE
	bool
	default y
endmenu
menu "cmsis-nn (D:/Downloads/nordictest/sdk/modules/lib/cmsis-nn)"
osource "$(ZEPHYR_CMSIS_NN_KCONFIG)"
config ZEPHYR_CMSIS_NN_MODULE
	bool
	default y
endmenu
menu "fatfs (D:/Downloads/nordictest/sdk/modules/fs/fatfs)"
osource "$(ZEPHYR_FATFS_KCONFIG)"
config ZEPHYR_FATFS_MODULE
	bool
	default y
endmenu
menu "hal_nordic (D:/Downloads/nordictest/sdk/modules/hal/nordic)"
osource "$(ZEPHYR_HAL_NORDIC_KCONFIG)"
config ZEPHYR_HAL_NORDIC_MODULE
	bool
	default y

config ZEPHYR_HAL_NORDIC_MODULE_BLOBS
	bool
endmenu
menu "hal_st (D:/Downloads/nordictest/sdk/modules/hal/st)"
osource "$(ZEPHYR_HAL_ST_KCONFIG)"
config ZEPHYR_HAL_ST_MODULE
	bool
	default y
endmenu
config ZEPHYR_HAL_WURTHELEKTRONIK_MODULE
	bool
	default y
menu "hostap (D:/Downloads/nordictest/sdk/modules/lib/hostap)"
osource "$(ZEPHYR_HOSTAP_KCONFIG)"
config ZEPHYR_HOSTAP_MODULE
	bool
	default y
endmenu
config ZEPHYR_LIBMETAL_MODULE
	bool
	default y
menu "liblc3 (D:/Downloads/nordictest/sdk/modules/lib/liblc3)"
osource "$(ZEPHYR_LIBLC3_KCONFIG)"
config ZEPHYR_LIBLC3_MODULE
	bool
	default y
endmenu
menu "littlefs (D:/Downloads/nordictest/sdk/modules/fs/littlefs)"
osource "$(ZEPHYR_LITTLEFS_KCONFIG)"
config ZEPHYR_LITTLEFS_MODULE
	bool
	default y
endmenu
menu "loramac-node (D:/Downloads/nordictest/sdk/modules/lib/loramac-node)"
osource "$(ZEPHYR_LORAMAC_NODE_KCONFIG)"
config ZEPHYR_LORAMAC_NODE_MODULE
	bool
	default y
endmenu
menu "lvgl (D:/Downloads/nordictest/sdk/modules/lib/gui/lvgl)"
osource "D:/Downloads/nordictest/sdk/modules/lib/gui/lvgl/Kconfig"
config ZEPHYR_LVGL_MODULE
	bool
	default y
endmenu
config ZEPHYR_MIPI_SYS_T_MODULE
	bool
	default y
menu "nrf_wifi (D:/Downloads/nordictest/sdk/modules/lib/nrf_wifi)"
osource "$(ZEPHYR_NRF_WIFI_KCONFIG)"
config ZEPHYR_NRF_WIFI_MODULE
	bool
	default y

config ZEPHYR_NRF_WIFI_MODULE_BLOBS
	bool
endmenu
config ZEPHYR_OPEN_AMP_MODULE
	bool
	default y
menu "picolibc (D:/Downloads/nordictest/sdk/modules/lib/picolibc)"
osource "D:/Downloads/nordictest/sdk/modules/lib/picolibc/zephyr/Kconfig"
config ZEPHYR_PICOLIBC_MODULE
	bool
	default y
endmenu
menu "segger (D:/Downloads/nordictest/sdk/modules/debug/segger)"
osource "$(ZEPHYR_SEGGER_KCONFIG)"
config ZEPHYR_SEGGER_MODULE
	bool
	default y
endmenu
config ZEPHYR_TINYCRYPT_MODULE
	bool
	default y
menu "uoscore-uedhoc (D:/Downloads/nordictest/sdk/modules/lib/uoscore-uedhoc)"
osource "$(ZEPHYR_UOSCORE_UEDHOC_KCONFIG)"
config ZEPHYR_UOSCORE_UEDHOC_MODULE
	bool
	default y
endmenu
menu "zcbor (D:/Downloads/nordictest/sdk/modules/lib/zcbor)"
osource "$(ZEPHYR_ZCBOR_KCONFIG)"
config ZEPHYR_ZCBOR_MODULE
	bool
	default y
endmenu
menu "nrfxlib (D:/Downloads/nordictest/sdk/nrfxlib)"
osource "D:/Downloads/nordictest/sdk/nrfxlib/Kconfig.nrfxlib"
config ZEPHYR_NRFXLIB_MODULE
	bool
	default y
endmenu
config ZEPHYR_NRF_HW_MODELS_MODULE
	bool
	default y
menu "connectedhomeip (D:/Downloads/nordictest/sdk/modules/lib/matter)"
osource "D:/Downloads/nordictest/sdk/modules/lib/matter/config/nrfconnect/chip-module/Kconfig"
config ZEPHYR_CONNECTEDHOMEIP_MODULE
	bool
	default y
endmenu
```

## build_6/Kconfig/Kconfig.shield
```kconfig
osource "D:/Downloads/nordictest/blinky_pwm/boards/shields/*/Kconfig.shield"
osource "D:/Downloads/nordictest/sdk/nrf/boards/shields/*/Kconfig.shield"
```

## build_6/Kconfig/Kconfig.shield.defconfig
```kconfig
osource "D:/Downloads/nordictest/blinky_pwm/boards/shields/*/Kconfig.defconfig"
osource "D:/Downloads/nordictest/sdk/nrf/boards/shields/*/Kconfig.defconfig"
```

## build_6/Kconfig/soc/Kconfig
```kconfig
# Load Zephyr SoC Kconfig descriptions.
osource "D:/Downloads/nordictest/sdk/zephyr/soc/xlnx/zynqmp/Kconfig"
osource "D:/Downloads/nordictest/sdk/zephyr/soc/xlnx/zynq7000/Kconfig"
osource "D:/Downloads/nordictest/sdk/zephyr/soc/xen/Kconfig"
osource "D:/Downloads/nordictest/sdk/zephyr/soc/ti/simplelink/Kconfig"
osource "D:/Downloads/nordictest/sdk/zephyr/soc/ti/lm3s6965/Kconfig"
osource "D:/Downloads/nordictest/sdk/zephyr/soc/ti/k3/Kconfig"
osource "D:/Downloads/nordictest/sdk/zephyr/soc/telink/tlsr/Kconfig"
osource "D:/Downloads/nordictest/sdk/zephyr/soc/starfive/jh71xx/Kconfig"
osource "D:/Downloads/nordictest/sdk/zephyr/soc/st/stm32/Kconfig"
osource "D:/Downloads/nordictest/sdk/zephyr/soc/snps/qemu_arc/Kconfig"
osource "D:/Downloads/nordictest/sdk/zephyr/soc/snps/nsim/arc_v/Kconfig"
osource "D:/Downloads/nordictest/sdk/zephyr/soc/snps/nsim/arc_classic/Kconfig"
osource "D:/Downloads/nordictest/sdk/zephyr/soc/snps/hsdk4xd/Kconfig"
osource "D:/Downloads/nordictest/sdk/zephyr/soc/snps/hsdk/Kconfig"
osource "D:/Downloads/nordictest/sdk/zephyr/soc/snps/emsk/Kconfig"
osource "D:/Downloads/nordictest/sdk/zephyr/soc/snps/emsdp/Kconfig"
osource "D:/Downloads/nordictest/sdk/zephyr/soc/snps/arc_iot/Kconfig"
osource "D:/Downloads/nordictest/sdk/zephyr/soc/silabs/Kconfig"
osource "D:/Downloads/nordictest/sdk/zephyr/soc/sifive/sifive_freedom/Kconfig"
osource "D:/Downloads/nordictest/sdk/zephyr/soc/sensry/Kconfig"
osource "D:/Downloads/nordictest/sdk/zephyr/soc/rockchip/Kconfig"
osource "D:/Downloads/nordictest/sdk/zephyr/soc/renode/riscv_virtual/Kconfig"
osource "D:/Downloads/nordictest/sdk/zephyr/soc/renode/cortex_r8_virtual/Kconfig"
osource "D:/Downloads/nordictest/sdk/zephyr/soc/renesas/smartbond/Kconfig"
osource "D:/Downloads/nordictest/sdk/zephyr/soc/renesas/rzt2m/Kconfig"
osource "D:/Downloads/nordictest/sdk/zephyr/soc/renesas/rcar/Kconfig"
osource "D:/Downloads/nordictest/sdk/zephyr/soc/renesas/ra/Kconfig"
osource "D:/Downloads/nordictest/sdk/zephyr/soc/raspberrypi/Kconfig"
osource "D:/Downloads/nordictest/sdk/zephyr/soc/quicklogic/eos_s3/Kconfig"
osource "D:/Downloads/nordictest/sdk/zephyr/soc/qemu/virt_riscv/Kconfig"
osource "D:/Downloads/nordictest/sdk/zephyr/soc/qemu/malta/Kconfig"
osource "D:/Downloads/nordictest/sdk/zephyr/soc/openisa/rv32m1/Kconfig"
osource "D:/Downloads/nordictest/sdk/zephyr/soc/nxp/s32/Kconfig"
osource "D:/Downloads/nordictest/sdk/zephyr/soc/nxp/rw/Kconfig"
osource "D:/Downloads/nordictest/sdk/zephyr/soc/nxp/mcx/Kconfig"
osource "D:/Downloads/nordictest/sdk/zephyr/soc/nxp/lpc/Kconfig"
osource "D:/Downloads/nordictest/sdk/zephyr/soc/nxp/layerscape/Kconfig"
osource "D:/Downloads/nordictest/sdk/zephyr/soc/nxp/kinetis/Kconfig"
osource "D:/Downloads/nordictest/sdk/zephyr/soc/nxp/imxrt/Kconfig"
osource "D:/Downloads/nordictest/sdk/zephyr/soc/nxp/imx/Kconfig"
osource "D:/Downloads/nordictest/sdk/zephyr/soc/nuvoton/numicro/Kconfig"
osource "D:/Downloads/nordictest/sdk/zephyr/soc/nuvoton/numaker/Kconfig"
osource "D:/Downloads/nordictest/sdk/zephyr/soc/nuvoton/npcx/Kconfig"
osource "D:/Downloads/nordictest/sdk/zephyr/soc/nuvoton/npcm/Kconfig"
osource "D:/Downloads/nordictest/sdk/zephyr/soc/nordic/Kconfig"
osource "D:/Downloads/nordictest/sdk/zephyr/soc/neorv32/Kconfig"
osource "D:/Downloads/nordictest/sdk/zephyr/soc/native/inf_clock/Kconfig"
osource "D:/Downloads/nordictest/sdk/zephyr/soc/microchip/miv/Kconfig"
osource "D:/Downloads/nordictest/sdk/zephyr/soc/microchip/mec/Kconfig"
osource "D:/Downloads/nordictest/sdk/zephyr/soc/mediatek/mtk_adsp/Kconfig"
osource "D:/Downloads/nordictest/sdk/zephyr/soc/lowrisc/opentitan/Kconfig"
osource "D:/Downloads/nordictest/sdk/zephyr/soc/litex/litex_vexriscv/Kconfig"
osource "D:/Downloads/nordictest/sdk/zephyr/soc/ite/ec/Kconfig"
osource "D:/Downloads/nordictest/sdk/zephyr/soc/intel/raptor_lake/Kconfig"
osource "D:/Downloads/nordictest/sdk/zephyr/soc/intel/lakemont/Kconfig"
osource "D:/Downloads/nordictest/sdk/zephyr/soc/intel/intel_socfpga_std/Kconfig"
osource "D:/Downloads/nordictest/sdk/zephyr/soc/intel/intel_socfpga/Kconfig"
osource "D:/Downloads/nordictest/sdk/zephyr/soc/intel/intel_niosv/Kconfig"
osource "D:/Downloads/nordictest/sdk/zephyr/soc/intel/intel_ish/Kconfig"
osource "D:/Downloads/nordictest/sdk/zephyr/soc/intel/intel_adsp/Kconfig"
osource "D:/Downloads/nordictest/sdk/zephyr/soc/intel/elkhart_lake/Kconfig"
osource "D:/Downloads/nordictest/sdk/zephyr/soc/intel/atom/Kconfig"
osource "D:/Downloads/nordictest/sdk/zephyr/soc/intel/apollo_lake/Kconfig"
osource "D:/Downloads/nordictest/sdk/zephyr/soc/intel/alder_lake/Kconfig"
osource "D:/Downloads/nordictest/sdk/zephyr/soc/infineon/cat3/Kconfig"
osource "D:/Downloads/nordictest/sdk/zephyr/soc/infineon/cat1b/Kconfig"
osource "D:/Downloads/nordictest/sdk/zephyr/soc/infineon/cat1a/Kconfig"
osource "D:/Downloads/nordictest/sdk/zephyr/soc/gd/gd32/Kconfig"
osource "D:/Downloads/nordictest/sdk/zephyr/soc/gaisler/leon3/Kconfig"
osource "D:/Downloads/nordictest/sdk/zephyr/soc/gaisler/gr716a/Kconfig"
osource "D:/Downloads/nordictest/sdk/zephyr/soc/espressif/Kconfig"
osource "D:/Downloads/nordictest/sdk/zephyr/soc/ene/kb1200/Kconfig"
osource "D:/Downloads/nordictest/sdk/zephyr/soc/efinix/sapphire/Kconfig"
osource "D:/Downloads/nordictest/sdk/zephyr/soc/cdns/xtensa_sample_controller/Kconfig"
osource "D:/Downloads/nordictest/sdk/zephyr/soc/cdns/dc233c/Kconfig"
osource "D:/Downloads/nordictest/sdk/zephyr/soc/brcm/bcmvk/Kconfig"
osource "D:/Downloads/nordictest/sdk/zephyr/soc/brcm/bcm2712/Kconfig"
osource "D:/Downloads/nordictest/sdk/zephyr/soc/brcm/bcm2711/Kconfig"
osource "D:/Downloads/nordictest/sdk/zephyr/soc/atmel/sam0/Kconfig"
osource "D:/Downloads/nordictest/sdk/zephyr/soc/atmel/sam/Kconfig"
osource "D:/Downloads/nordictest/sdk/zephyr/soc/aspeed/Kconfig"
osource "D:/Downloads/nordictest/sdk/zephyr/soc/arm/Kconfig"
osource "D:/Downloads/nordictest/sdk/zephyr/soc/arm/beetle/Kconfig"
osource "D:/Downloads/nordictest/sdk/zephyr/soc/andestech/Kconfig"
osource "D:/Downloads/nordictest/sdk/zephyr/soc/ambiq/Kconfig"
osource "D:/Downloads/nordictest/sdk/zephyr/soc/altr/zephyr_nios2f/Kconfig"
osource "D:/Downloads/nordictest/sdk/zephyr/soc/altr/qemu_nios2/Kconfig"
osource "D:/Downloads/nordictest/sdk/zephyr/soc/adi/max32/Kconfig"
```
