## build_6/Kconfig/soc/Kconfig.soc
```kconfig
# Load SoC Kconfig descriptions.
osource "D:/Downloads/nordictest/sdk/zephyr/soc/xlnx/zynqmp/Kconfig.soc"
osource "D:/Downloads/nordictest/sdk/zephyr/soc/xlnx/zynq7000/Kconfig.soc"
osource "D:/Downloads/nordictest/sdk/zephyr/soc/xen/Kconfig.soc"
osource "D:/Downloads/nordictest/sdk/zephyr/soc/ti/simplelink/Kconfig.soc"
osource "D:/Downloads/nordictest/sdk/zephyr/soc/ti/lm3s6965/Kconfig.soc"
osource "D:/Downloads/nordictest/sdk/zephyr/soc/ti/k3/Kconfig.soc"
osource "D:/Downloads/nordictest/sdk/zephyr/soc/telink/tlsr/Kconfig.soc"
osource "D:/Downloads/nordictest/sdk/zephyr/soc/starfive/jh71xx/Kconfig.soc"
osource "D:/Downloads/nordictest/sdk/zephyr/soc/st/stm32/Kconfig.soc"
osource "D:/Downloads/nordictest/sdk/zephyr/soc/snps/qemu_arc/Kconfig.soc"
osource "D:/Downloads/nordictest/sdk/zephyr/soc/snps/nsim/arc_v/Kconfig.soc"
osource "D:/Downloads/nordictest/sdk/zephyr/soc/snps/nsim/arc_classic/Kconfig.soc"
osource "D:/Downloads/nordictest/sdk/zephyr/soc/snps/hsdk4xd/Kconfig.soc"
osource "D:/Downloads/nordictest/sdk/zephyr/soc/snps/hsdk/Kconfig.soc"
osource "D:/Downloads/nordictest/sdk/zephyr/soc/snps/emsk/Kconfig.soc"
osource "D:/Downloads/nordictest/sdk/zephyr/soc/snps/emsdp/Kconfig.soc"
osource "D:/Downloads/nordictest/sdk/zephyr/soc/snps/arc_iot/Kconfig.soc"
osource "D:/Downloads/nordictest/sdk/zephyr/soc/silabs/Kconfig.soc"
osource "D:/Downloads/nordictest/sdk/zephyr/soc/sifive/sifive_freedom/Kconfig.soc"
osource "D:/Downloads/nordictest/sdk/zephyr/soc/sensry/Kconfig.soc"
osource "D:/Downloads/nordictest/sdk/zephyr/soc/rockchip/Kconfig.soc"
osource "D:/Downloads/nordictest/sdk/zephyr/soc/renode/riscv_virtual/Kconfig.soc"
osource "D:/Downloads/nordictest/sdk/zephyr/soc/renode/cortex_r8_virtual/Kconfig.soc"
osource "D:/Downloads/nordictest/sdk/zephyr/soc/renesas/smartbond/Kconfig.soc"
osource "D:/Downloads/nordictest/sdk/zephyr/soc/renesas/rzt2m/Kconfig.soc"
osource "D:/Downloads/nordictest/sdk/zephyr/soc/renesas/rcar/Kconfig.soc"
osource "D:/Downloads/nordictest/sdk/zephyr/soc/renesas/ra/Kconfig.soc"
osource "D:/Downloads/nordictest/sdk/zephyr/soc/raspberrypi/Kconfig.soc"
osource "D:/Downloads/nordictest/sdk/zephyr/soc/quicklogic/eos_s3/Kconfig.soc"
osource "D:/Downloads/nordictest/sdk/zephyr/soc/qemu/virt_riscv/Kconfig.soc"
osource "D:/Downloads/nordictest/sdk/zephyr/soc/qemu/malta/Kconfig.soc"
osource "D:/Downloads/nordictest/sdk/zephyr/soc/openisa/rv32m1/Kconfig.soc"
osource "D:/Downloads/nordictest/sdk/zephyr/soc/nxp/s32/Kconfig.soc"
osource "D:/Downloads/nordictest/sdk/zephyr/soc/nxp/rw/Kconfig.soc"
osource "D:/Downloads/nordictest/sdk/zephyr/soc/nxp/mcx/Kconfig.soc"
osource "D:/Downloads/nordictest/sdk/zephyr/soc/nxp/lpc/Kconfig.soc"
osource "D:/Downloads/nordictest/sdk/zephyr/soc/nxp/layerscape/Kconfig.soc"
osource "D:/Downloads/nordictest/sdk/zephyr/soc/nxp/kinetis/Kconfig.soc"
osource "D:/Downloads/nordictest/sdk/zephyr/soc/nxp/imxrt/Kconfig.soc"
osource "D:/Downloads/nordictest/sdk/zephyr/soc/nxp/imx/Kconfig.soc"
osource "D:/Downloads/nordictest/sdk/zephyr/soc/nuvoton/numicro/Kconfig.soc"
osource "D:/Downloads/nordictest/sdk/zephyr/soc/nuvoton/numaker/Kconfig.soc"
osource "D:/Downloads/nordictest/sdk/zephyr/soc/nuvoton/npcx/Kconfig.soc"
osource "D:/Downloads/nordictest/sdk/zephyr/soc/nuvoton/npcm/Kconfig.soc"
osource "D:/Downloads/nordictest/sdk/zephyr/soc/nordic/Kconfig.soc"
osource "D:/Downloads/nordictest/sdk/zephyr/soc/neorv32/Kconfig.soc"
osource "D:/Downloads/nordictest/sdk/zephyr/soc/native/inf_clock/Kconfig.soc"
osource "D:/Downloads/nordictest/sdk/zephyr/soc/microchip/miv/Kconfig.soc"
osource "D:/Downloads/nordictest/sdk/zephyr/soc/microchip/mec/Kconfig.soc"
osource "D:/Downloads/nordictest/sdk/zephyr/soc/mediatek/mtk_adsp/Kconfig.soc"
osource "D:/Downloads/nordictest/sdk/zephyr/soc/lowrisc/opentitan/Kconfig.soc"
osource "D:/Downloads/nordictest/sdk/zephyr/soc/litex/litex_vexriscv/Kconfig.soc"
osource "D:/Downloads/nordictest/sdk/zephyr/soc/ite/ec/Kconfig.soc"
osource "D:/Downloads/nordictest/sdk/zephyr/soc/intel/raptor_lake/Kconfig.soc"
osource "D:/Downloads/nordictest/sdk/zephyr/soc/intel/lakemont/Kconfig.soc"
osource "D:/Downloads/nordictest/sdk/zephyr/soc/intel/intel_socfpga_std/Kconfig.soc"
osource "D:/Downloads/nordictest/sdk/zephyr/soc/intel/intel_socfpga/Kconfig.soc"
osource "D:/Downloads/nordictest/sdk/zephyr/soc/intel/intel_niosv/Kconfig.soc"
osource "D:/Downloads/nordictest/sdk/zephyr/soc/intel/intel_ish/Kconfig.soc"
osource "D:/Downloads/nordictest/sdk/zephyr/soc/intel/intel_adsp/Kconfig.soc"
osource "D:/Downloads/nordictest/sdk/zephyr/soc/intel/elkhart_lake/Kconfig.soc"
osource "D:/Downloads/nordictest/sdk/zephyr/soc/intel/atom/Kconfig.soc"
osource "D:/Downloads/nordictest/sdk/zephyr/soc/intel/apollo_lake/Kconfig.soc"
osource "D:/Downloads/nordictest/sdk/zephyr/soc/intel/alder_lake/Kconfig.soc"
osource "D:/Downloads/nordictest/sdk/zephyr/soc/infineon/cat3/Kconfig.soc"
osource "D:/Downloads/nordictest/sdk/zephyr/soc/infineon/cat1b/Kconfig.soc"
osource "D:/Downloads/nordictest/sdk/zephyr/soc/infineon/cat1a/Kconfig.soc"
osource "D:/Downloads/nordictest/sdk/zephyr/soc/gd/gd32/Kconfig.soc"
osource "D:/Downloads/nordictest/sdk/zephyr/soc/gaisler/leon3/Kconfig.soc"
osource "D:/Downloads/nordictest/sdk/zephyr/soc/gaisler/gr716a/Kconfig.soc"
osource "D:/Downloads/nordictest/sdk/zephyr/soc/espressif/Kconfig.soc"
osource "D:/Downloads/nordictest/sdk/zephyr/soc/ene/kb1200/Kconfig.soc"
osource "D:/Downloads/nordictest/sdk/zephyr/soc/efinix/sapphire/Kconfig.soc"
osource "D:/Downloads/nordictest/sdk/zephyr/soc/cdns/xtensa_sample_controller/Kconfig.soc"
osource "D:/Downloads/nordictest/sdk/zephyr/soc/cdns/dc233c/Kconfig.soc"
osource "D:/Downloads/nordictest/sdk/zephyr/soc/brcm/bcmvk/Kconfig.soc"
osource "D:/Downloads/nordictest/sdk/zephyr/soc/brcm/bcm2712/Kconfig.soc"
osource "D:/Downloads/nordictest/sdk/zephyr/soc/brcm/bcm2711/Kconfig.soc"
osource "D:/Downloads/nordictest/sdk/zephyr/soc/atmel/sam0/Kconfig.soc"
osource "D:/Downloads/nordictest/sdk/zephyr/soc/atmel/sam/Kconfig.soc"
osource "D:/Downloads/nordictest/sdk/zephyr/soc/aspeed/Kconfig.soc"
osource "D:/Downloads/nordictest/sdk/zephyr/soc/arm/Kconfig.soc"
osource "D:/Downloads/nordictest/sdk/zephyr/soc/arm/beetle/Kconfig.soc"
osource "D:/Downloads/nordictest/sdk/zephyr/soc/andestech/Kconfig.soc"
osource "D:/Downloads/nordictest/sdk/zephyr/soc/ambiq/Kconfig.soc"
osource "D:/Downloads/nordictest/sdk/zephyr/soc/altr/zephyr_nios2f/Kconfig.soc"
osource "D:/Downloads/nordictest/sdk/zephyr/soc/altr/qemu_nios2/Kconfig.soc"
osource "D:/Downloads/nordictest/sdk/zephyr/soc/adi/max32/Kconfig.soc"
```

## build_8/Kconfig/arch/Kconfig
```kconfig
# Load Zephyr Arch Kconfig descriptions.
osource "D:/Downloads/nordictest/sdk/zephyr/arch/x86/Kconfig"
osource "D:/Downloads/nordictest/sdk/zephyr/arch/xtensa/Kconfig"
osource "D:/Downloads/nordictest/sdk/zephyr/arch/sparc/Kconfig"
osource "D:/Downloads/nordictest/sdk/zephyr/arch/riscv/Kconfig"
osource "D:/Downloads/nordictest/sdk/zephyr/arch/posix/Kconfig"
osource "D:/Downloads/nordictest/sdk/zephyr/arch/nios2/Kconfig"
osource "D:/Downloads/nordictest/sdk/zephyr/arch/mips/Kconfig"
osource "D:/Downloads/nordictest/sdk/zephyr/arch/arm64/Kconfig"
osource "D:/Downloads/nordictest/sdk/zephyr/arch/arm/Kconfig"
osource "D:/Downloads/nordictest/sdk/zephyr/arch/arc/Kconfig"
```
